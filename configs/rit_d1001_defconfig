## configs/rit_d1001_defconfig
```kconfig
BR2_arm=y
BR2_SVN="svn"
BR2_SHARED_STATIC_LIBS=y
BR2_TOOLCHAIN_BUILDROOT_VENDOR="nuvoton"
BR2_TOOLCHAIN_BUILDROOT_LOCALE=y
BR2_TOOLCHAIN_BUILDROOT_CXX=y
BR2_PACKAGE_HOST_GDB=y
BR2_TARGET_GENERIC_HOSTNAME="d1001"
BR2_TARGET_GENERIC_ISSUE="Welcome to DAS Service"
BR2_ROOTFS_DEVICE_CREATION_DYNAMIC_MDEV=y
BR2_TARGET_GENERIC_ROOT_PASSWD="d1001"
BR2_TARGET_GENERIC_GETTY_BAUDRATE_115200=y
BR2_ROOTFS_OVERLAY="board/rit/d1001/rootfs_overlay"
BR2_LINUX_KERNEL=y
BR2_LINUX_KERNEL_CUSTOM_TARBALL=y
BR2_LINUX_KERNEL_CUSTOM_TARBALL_LOCATION="$(call github,ser-sap,NUC980-linux-5.10.y,master)/NUC980-linux-5.10.y-master.tar.gz"
BR2_LINUX_KERNEL_DEFCONFIG="nuc980_d1001"
BR2_LINUX_KERNEL_UIMAGE=y
BR2_LINUX_KERNEL_DTS_SUPPORT=y
BR2_LINUX_KERNEL_INTREE_DTS_NAME="nuc980-d1001"
BR2_PACKAGE_BZIP2=y
BR2_PACKAGE_ZIP=y
BR2_PACKAGE_GETTEXT=y
BR2_PACKAGE_ZLIB=y
BR2_PACKAGE_LIBAIO=y
BR2_PACKAGE_NCURSES=y
BR2_TARGET_ROOTFS_INITRAMFS=y
BR2_TARGET_UBOOT=y
BR2_TARGET_UBOOT_BUILD_SYSTEM_KCONFIG=y
BR2_TARGET_UBOOT_CUSTOM_TARBALL=y
BR2_TARGET_UBOOT_CUSTOM_TARBALL_LOCATION="$(call github,ser-sap,NUC970_U-Boot_v2016.11,master)/NUC970_U-Boot_v2016.11-master.tar.gz"
BR2_TARGET_UBOOT_BOARD_DEFCONFIG="nuc980_d1001"
BR2_PACKAGE_HOST_ENVIRONMENT_SETUP=y
```
